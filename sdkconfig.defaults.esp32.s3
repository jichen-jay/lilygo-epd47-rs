## sdkconfig.defaults.esp32.s3
```kconfig
CONFIG_IDF_TARGET="esp32s3"
CONFIG_IDF_TARGET_ESP32S3=y

# PSRAM Configuration (important for your display driver)
CONFIG_SPIRAM=y
CONFIG_SPIRAM_MODE_QUAD=y
CONFIG_SPIRAM_TYPE_AUTO=y
CONFIG_SPIRAM_SIZE_8MB=y
CONFIG_SPIRAM_SPEED_80M=y
CONFIG_SPIRAM_BOOT_INIT=y
CONFIG_SPIRAM_USE_MALLOC=y
CONFIG_SPIRAM_USE_CAPS_ALLOC=y
CONFIG_SPIRAM_USE_MEMMAP=y

# Memory Configuration
CONFIG_SPIRAM_ALLOW_BSS_SEG_EXTERNAL_MEMORY=y
CONFIG_SPIRAM_ALLOW_NOINIT_SEG_EXTERNAL_MEMORY=y
CONFIG_SPIRAM_ALLOW_STACK_EXTERNAL_MEMORY=y

# LCD/Camera Configuration
CONFIG_LCD_CAM_ENABLE=y

# RMT Configuration  
CONFIG_RMT_ENABLE=y

# GPIO Configuration
CONFIG_GPIO_ESP32_SUPPORT_SWITCH_SLP_PULL=y

# Optimization
CONFIG_COMPILER_OPTIMIZATION_SIZE=y
CONFIG_COMPILER_OPTIMIZATION_ASSERTIONS_SILENT=y

# Bootloader
CONFIG_BOOTLOADER_COMPILER_OPTIMIZATION_SIZE=y

# Component Configuration
CONFIG_LWIP_LOCAL_HOSTNAME="lilygo-epd47"
```

## slint-chat-epd47/sdkconfig.defaults
```kconfig
# Minimal ESP32-S3 Configuration for Slint UI Demo

# Enable PSRAM (required for Slint framebuffers)
CONFIG_ESP32S3_SPIRAM_SUPPORT=y
CONFIG_SPIRAM_MODE_OCT=y
CONFIG_SPIRAM_SPEED_80M=y
CONFIG_SPIRAM_USE_MALLOC=y

# Memory configuration for Slint
CONFIG_ESP_MAIN_TASK_STACK_SIZE=16384

# Logging
CONFIG_LOG_DEFAULT_LEVEL_INFO=y

# Partition table
CONFIG_PARTITION_TABLE_SINGLE_APP_LARGE=y

# Optimization
CONFIG_COMPILER_OPTIMIZATION_SIZE=y
```
